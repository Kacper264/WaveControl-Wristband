## sdkconfig.defaults
```kconfig
# --- PSRAM / SPIRAM ---
CONFIG_SPIRAM=y
CONFIG_SPIRAM_BOOT_INIT=y
CONFIG_SPIRAM_USE_MALLOC=y
CONFIG_SPIRAM_MEMTEST=n

# ESP32-S3 XIAO utilise typiquement de l'OCTAL PSRAM
CONFIG_SPIRAM_MODE_OCT=y
CONFIG_SPIRAM_SPEED_80M=y
```
